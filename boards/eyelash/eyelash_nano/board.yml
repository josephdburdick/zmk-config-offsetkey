## boards/eyelash/eyelash_nano/board.yml
```yaml
board:
  name: eyelash_nano
  vendor: eyelash
  socs:
    - name: nrf52840
      variants:
        - name: zmk
  revision:
    format: major.minor.patch
    default: 1.0.0
    revisions:
      - name: 1.0.0
```
